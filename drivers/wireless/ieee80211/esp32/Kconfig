## misc/buildroot/toolchain/gcc/Config.in
```kconfig
# Choose gcc version.

comment "GCC Options"

choice
	prompt "GCC compiler Version"
	default BR2_GCC_VERSION_4_2_4 if !BR2_avr32
	default BR2_GCC_VERSION_3_4_6 if BR2_avr32
	help
	  Select the version of gcc you wish to use.

#	config BR2_GCC_VERSION_3_3_5
#		depends !BR2_nios2 && BR2_DEPRECATED
#		bool "gcc 3.3.5"

#	config BR2_GCC_VERSION_3_3_6
#		depends !BR2_nios2 && BR2_DEPRECATED
#		bool "gcc 3.3.6"

#	config BR2_GCC_VERSION_3_4_2
#		depends BR2_DEPRECATED
#		bool "gcc 3.4.2"

#	config BR2_GCC_VERSION_3_4_3
#		depends BR2_DEPRECATED
#		bool "gcc 3.4.3"

#	config BR2_GCC_VERSION_3_4_4
#		depends BR2_DEPRECATED
#		bool "gcc 3.4.4"

#	config BR2_GCC_VERSION_3_4_5
#		depends BR2_DEPRECATED
#		bool "gcc 3.4.5"

	config BR2_GCC_VERSION_3_4_6
		depends on !BR2_m32c
		bool "gcc 3.4.6"

#	config BR2_GCC_VERSION_4_0_0
#		depends !BR2_nios2 && BR2_DEPRECATED
#		bool "gcc 4.0.0"

#	config BR2_GCC_VERSION_4_0_1
#		depends !BR2_nios2 && BR2_DEPRECATED
#		bool "gcc 4.0.1"

#	config BR2_GCC_VERSION_4_0_2
#		depends !BR2_nios2 && BR2_DEPRECATED
#		bool "gcc 4.0.2"

#	config BR2_GCC_VERSION_4_0_3
#		depends !BR2_nios2 && BR2_DEPRECATED
#		bool "gcc 4.0.3"

#	config BR2_GCC_VERSION_4_0_4
#		depends !BR2_nios2 && BR2_DEPRECATED
#		bool "gcc 4.0.4"

#	config BR2_GCC_VERSION_4_1_0
#		depends !BR2_nios2 && BR2_DEPRECATED
#		bool "gcc 4.1.0"

#	config BR2_GCC_VERSION_4_1_1
#		depends !BR2_nios2 && BR2_DEPRECATED
#		bool "gcc 4.1.1"

#	config BR2_GCC_VERSION_4_1_2
#		depends !BR2_nios2 && BR2_DEPRECATED
#		bool "gcc 4.1.2"

#	config BR2_GCC_VERSION_4_2
#		depends !BR2_nios2 && BR2_DEPRECATED
#		bool "gcc 4.2"

	config BR2_GCC_VERSION_4_2_4
		depends on !BR2_avr32 && !BR2_nios2
		select BR2_GCC_SUPPORTS_SYSROOT
		bool "gcc 4.2.4"

endchoice

config BR2_GCC_SUPPORTS_SYSROOT
	bool
	default n

config BR2_GCC_VERSION
	string
#	default "3.3.5"     if BR2_GCC_VERSION_3_3_5
#	default "3.3.6"     if BR2_GCC_VERSION_3_3_6
#	default "3.4.2"     if BR2_GCC_VERSION_3_4_2
#	default "3.4.3"     if BR2_GCC_VERSION_3_4_3
#	default "3.4.4"     if BR2_GCC_VERSION_3_4_4
#	default "3.4.5"     if BR2_GCC_VERSION_3_4_5
	default "3.4.6"     if BR2_GCC_VERSION_3_4_6
#	default "4.0.0"     if BR2_GCC_VERSION_4_0_0
#	default "4.0.1"     if BR2_GCC_VERSION_4_0_1
#	default "4.0.2"     if BR2_GCC_VERSION_4_0_2
#	default "4.0.3"     if BR2_GCC_VERSION_4_0_3
#	default "4.0.4"     if BR2_GCC_VERSION_4_0_4
#	default "4.1.0"     if BR2_GCC_VERSION_4_1_0
#	default "4.1.1"     if BR2_GCC_VERSION_4_1_1
#	default "4.1.2"     if BR2_GCC_VERSION_4_1_2
#	default "4.2"       if BR2_GCC_VERSION_4_2
	default "4.2.4"     if BR2_GCC_VERSION_4_2_4

#config BR2_TOOLCHAIN_SYSROOT
#	bool "Enable toolchain with --sysroot support"
#	depends on BR2_GCC_SUPPORTS_SYSROOT
#	default y
#	help
#	  Enables --sysroot=dir for binutils and gcc.
#	  Use dir as the logical root directory for headers and libraries.
#	  For example, if the compiler would normally search for headers in
#	  /usr/include and libraries in /usr/lib, it will instead search
#	  dir/usr/include and dir/usr/lib.
#
#	  This does not work with gcc < 4.2.0 (4.1.2 gets
#	  ORIGINAL_AS_FOR_TARGET wrong)

config BR2_GCC_USE_SJLJ_EXCEPTIONS
	bool "Enable setjmp/longjmp exceptions?"
	default n
	help
	  For some platforms, proper stack unwinding works perfectly,
	  while other platforms must use setjmp/longjmp exceptions for
	  proper stack unwinding during exception handling.  Most people
	  can leave this set to n.

config BR2_EXTRA_GCC_CONFIG_OPTIONS
	string "Additional gcc options"
	default ""
	help
	  Any additional gcc configure options you may want to include....

config BR2_INSTALL_LIBSTDCPP
	bool "Build C++ compiler?"
	default n
	# >= 4.2.0 work fine without LARGEFILE
	select BR2_LARGEFILE if !BR2_GCC_SUPPORTS_SYSROOT
	help
	  Build/install c++ compiler?  NOTE: libstdc++ is not built for NuttX?

config BR2_INSTALL_LIBGCJ
	bool "Build/install java compiler and libgcj?"
	default n
	depends on !BR2_avr32 && BR2_INSTALL_LIBSTDCPP
	help
	  Build/install java compiler and libgcj?

config BR2_INSTALL_OBJC
	bool "Build/install Objective-C compiler and runtime?"
	default n
	depends on !BR2_avr32
	help
	  Build/install Objective-C compiler and runtime?

config BR2_INSTALL_FORTRAN
	bool "Build/install Fortran compiler and runtime?"
	default n
	depends on !BR2_avr32
	help
	  Build/install Fortran compiler and runtime?
	  Note that it is highly recommended NOT to use gfortran
	  from gcc older than 4.2.0
```

## nuttx/configs/px4fmu-v1/Kconfig
```kconfig
#
# For a description of the syntax of this configuration file,
# see misc/tools/kconfig-language.txt.
#

if ARCH_BOARD_PX4FMU_V1

config CONFIG_HRT_TIMER
	bool "High resolution timer support"
	default y
	---help---
		Enable high resolution timer for PPM capture and system clocks.

config CONFIG_HRT_PPM
	bool "PPM input capture"
	default y
	depends on CONFIG_HRT_TIMER
	---help---
		Enable PPM input capture via HRT (for CPPM / PPM sum RC inputs)

endif
```
